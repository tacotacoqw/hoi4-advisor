## hardware/firmware/sdkconfig.defaults
```kconfig
# 参谋电报机：双向 UAC2 + CDC，无 UART0 控制台
CONFIG_ESPTOOLPY_FLASHSIZE_8MB=y
CONFIG_FREERTOS_HZ=1000
CONFIG_ESP_CONSOLE_NONE=y
CONFIG_ESP_CONSOLE_SECONDARY_NONE=y
CONFIG_UAC_TUSB_VID=0x303A
CONFIG_UAC_TUSB_PID=0x8D01
CONFIG_UAC_TUSB_MANUFACTURER="Field Voice"
CONFIG_UAC_TUSB_PRODUCT="参谋电报机"
CONFIG_UAC_SPEAKER_CHANNEL_NUM=1
CONFIG_UAC_MIC_CHANNEL_NUM=1
CONFIG_UAC_SAMPLE_RATE=48000
CONFIG_UAC_BIT_RESOLUTION_16=y
CONFIG_UAC_SUPPORT_MACOS=y

# 任务卡死超过 5 秒自动重启（不然只能拔线）
CONFIG_ESP_TASK_WDT_EN=y
CONFIG_ESP_TASK_WDT_INIT=y
CONFIG_ESP_TASK_WDT_PANIC=y
CONFIG_ESP_TASK_WDT_TIMEOUT_S=5
```
